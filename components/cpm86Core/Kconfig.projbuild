## components/cpm86Core/Kconfig.projbuild
```kconfig
menu "CP/M-86 (tiny8086 core)"

    config CPM86_TINY8086_IRAM
        bool "Place the 8086 interpreter in internal RAM"
        default y
        help
            Puts the whole tiny8086 object (code and its jump/parity tables) in IRAM/DRAM
            instead of flash-cached memory. Costs roughly 30 KB of IRAM; measured as
            clearly faster on the ESP32-S3.

endmenu
```

## main/Kconfig.projbuild
```kconfig
menu "Retro Host hardware"
  config RETRO_SD_MOSI
    int "SD SPI MOSI GPIO"
    range 0 48
    default 11
  config RETRO_SD_MISO
    int "SD SPI MISO GPIO"
    range 0 48
    default 13
  config RETRO_SD_CLK
    int "SD SPI clock GPIO"
    range 0 48
    default 12
  config RETRO_SD_CS
    int "SD SPI chip select GPIO"
    range 0 48
    default 10
endmenu

menu "CP/M-86 diagnostics"
  config CPM86_INSTRUCTION_TRACE
    bool "Capture instruction traces and opcode text"
    default y
    help
      Keep CP/M-86 instruction history and format decoded opcode bytes for
      diagnostic reports. Disable this option to measure CPU execution without
      instruction trace collection and formatting.
endmenu
```

## sdkconfig.defaults
```kconfig
CONFIG_IDF_TARGET="esp32s3"
CONFIG_ESPTOOLPY_FLASHSIZE_16MB=y
CONFIG_PARTITION_TABLE_CUSTOM=y
CONFIG_PARTITION_TABLE_CUSTOM_FILENAME="partitions.csv"
CONFIG_SPIRAM=y
CONFIG_SPIRAM_MODE_OCT=y
CONFIG_SPIRAM_TYPE_ESPPSRAM64=y
CONFIG_SPIRAM_SPEED_80M=y
CONFIG_SPIRAM_USE_CAPS_ALLOC=y
CONFIG_ESP_CONSOLE_USB_SERIAL_JTAG=y
CONFIG_ESP_CONSOLE_SECONDARY_NONE=y
CONFIG_ESP_MAIN_TASK_STACK_SIZE=8192
CONFIG_FATFS_LFN_HEAP=y
CONFIG_FATFS_MAX_LFN=255
CONFIG_FATFS_FS_LOCK=8
CONFIG_FATFS_TIMEOUT_MS=3000
CONFIG_HTTPD_MAX_URI_LEN=1024
CONFIG_HTTPD_MAX_REQ_HDR_LEN=2048
CONFIG_LWIP_MAX_SOCKETS=12
CONFIG_COMPILER_OPTIMIZATION_SIZE=y
CONFIG_LOG_DEFAULT_LEVEL_WARN=y
```
